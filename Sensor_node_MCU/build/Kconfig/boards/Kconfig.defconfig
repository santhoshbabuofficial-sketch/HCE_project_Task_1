## Sensor_node_MCU/build/Kconfig/boards/Kconfig.defconfig
```kconfig
# Load Zephyr board defconfig descriptions.
osource "/home/babu-inc-5831/zephyrproject/zephyr/boards/st/nucleo_g474re/Kconfig.defconfig"
```

## Sensor_node_MCU/build/Kconfig/boards/Kconfig.nucleo_g474re.tmp
```kconfig
# Load board Kconfig descriptions.
osource "/home/babu-inc-5831/zephyrproject/zephyr/boards/st/nucleo_g474re/Kconfig.nucleo_g474re"
```

## Sensor_node_MCU/build/Kconfig/boards/Kconfig.sysbuild.tmp
```kconfig
# Load Sysbuild board Kconfig descriptions.
osource "/home/babu-inc-5831/zephyrproject/zephyr/boards/st/nucleo_g474re/Kconfig.sysbuild"
```
